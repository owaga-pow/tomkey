/ {
  aml {
    compatible = "zmk,behavior-hold-tap";
    #address-cells = <1>;
    #size-cells = <0>;

    layer = <1>; // ← 自動で切り替わる先のレイヤー番号（例: Layer 3 = マウスレイヤー）
    timeout-ms = <10000>; // ← 自動切替までの待ち時間（ミリ秒）
  };
};
